## drivers/sensor/example_sensor/Kconfig
```kconfig
# Copyright (c) 2021 Nordic Semiconductor ASA
# SPDX-License-Identifier: Apache-2.0

config EXAMPLE_SENSOR
	bool "Example sensor"
	default y
	depends on DT_HAS_ZEPHYR_EXAMPLE_SENSOR_ENABLED
	select GPIO
	help
	  Enable example sensor

config CSV_FILE_PATH 
	string "Path to csv file"
	default "../MOCK_DATA.csv" 

config BUFFER_SIZE
	int "Line buffer size"
	default 128
```

## dts/bindings/sensor/zephyr,example-sensor.yaml
```yaml
# Copyright (c) 2021 Nordic Semiconductor ASA
# SPDX-License-Identifier: Apache-2.0

description: |
  Make a note

compatible: "zephyr,example-sensor"

include: base.yaml
```
