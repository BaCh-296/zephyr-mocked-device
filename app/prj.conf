## Kconfig
```
# Copyright (c) 2021 Nordic Semiconductor ASA
# SPDX-License-Identifier: Apache-2.0
#
# This file is the application Kconfig entry point. All application Kconfig
# options can be defined here or included via other application Kconfig files.
# You can browse these options using the west targets menuconfig (terminal) or
# guiconfig (GUI).

menu "Zephyr"
source "Kconfig.zephyr"
endmenu

config  TIMER_INTERVAL_MS
	int "Timer interval in miliseconds"
	default 1

module = APP
module-str = APP
source "subsys/logging/Kconfig.template.log_config"
```

## sample.yaml
```
# This file is provided so that the application can be compiled using Twister,
# the Zephyr testing tool. In this file, multiple combinations can be specified,
# so that you can easily test all of them locally or in CI.
sample:
  description: Example application
  name: example-application
common:
  integration_platforms:
    - native_sim
tests:
  zephyr.test.app:
    timeout: 5
    harness: console
    harness_config:
      type: multi_line
      ordered: false
      regex:
        - "loop"
    tags:
      - test_app
    platform_allow:
      - native_sim
```

## prj.conf
```kconfig
# Copyright (c) 2021 Nordic Semiconductor ASA
# SPDX-License-Identifier: Apache-2.0
#
# This is a Kconfig fragment which can be used to enable debug-related options
# in the application. See the README for more details.

# compiler
CONFIG_DEBUG_OPTIMIZATIONS=y

# logging
CONFIG_LOG=y
CONFIG_APP_LOG_LEVEL_DBG=y

CONFIG_SENSOR=y
```

## boards/native_sim.overlay
```dts
/*
 * Copyright (c) 2021 Nordic Semiconductor ASA
 * SPDX-License-Identifier: Apache-2.0
 */

/* This devicetree overlay file will be automatically picked by the Zephyr
 * build system when building the sample for the nucleo_f302r8 board. It shows
 * how the example-application can be built on sample boards already provided
 * by Zephyr.
 */

/ {
    example_sensor: example-sensor {
        compatible = "zephyr,example-sensor";
    };
};
```

## src/main.c
```c
/*
 * Copyright (c) 2021 Nordic Semiconductor ASA
 * SPDX-License-Identifier: Apache-2.0
 */

#include <zephyr/kernel.h>
#include <zephyr/logging/log.h>
#include <zephyr/device.h>
#include <zephyr/drivers/sensor.h>
#include <app_version.h>

LOG_MODULE_REGISTER(main);

static void timer_callback(struct k_timer *dummy);

static const struct device *sensor;

K_TIMER_DEFINE(my_timer, timer_callback, NULL);

static void timer_callback(struct k_timer *dummy)
{
	int ret;
	static struct sensor_value last_val = {0};
	struct sensor_value val;

	ret = sensor_sample_fetch(sensor);

	if (ret == -ENODATA)
	{
		LOG_INF("End of csv file.");
		k_timer_stop(&my_timer);
		return;
	}

	else if (ret < 0)
	{
		LOG_ERR("Could not fetch sample (%d)", ret);
		return;
	}

	ret = sensor_channel_get(sensor, SENSOR_CHAN_AMBIENT_TEMP, &val);

	if (ret == -ENODATA)
	{
		LOG_INF("No more sensor data.");
		k_timer_stop(&my_timer);
		return;
	}

	else if (ret < 0)
	{
		LOG_ERR("Could not get sample (%d)", ret);
		return;
	}

	if (last_val.val1 != val.val1)
	{
		LOG_INF("Temperature: %d", val.val1);
	}

	last_val = val;
}

int main()
{
	LOG_INF("Zephyr Example Application %s\n", APP_VERSION_STRING);

	sensor = DEVICE_DT_GET(DT_NODELABEL(example_sensor));

	while (!device_is_ready(sensor))
	{
		LOG_WRN("Sensor not ready");
		k_sleep(K_MSEC(100));
	}

	// Start the timer with the specified interval
	k_timer_start(&my_timer, K_NO_WAIT, K_MSEC(CONFIG_TIMER_INTERVAL_MS));

	return 0;
}
```
